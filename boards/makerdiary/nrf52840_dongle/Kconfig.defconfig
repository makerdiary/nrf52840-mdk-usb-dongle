## boards/makerdiary/nrf52840_dongle/Kconfig.defconfig
```kconfig
# nRF52840 MDK USB Dongle NRF52840 board configuration

# Copyright (c) 2016-2025 Makerdiary <https://makerdiary.com>
# SPDX-License-Identifier: Apache-2.0

if BOARD_NRF52840_DONGLE

config HW_STACK_PROTECTION
	default ARCH_HAS_STACK_PROTECTION

source "boards/common/usb/Kconfig.cdc_acm_serial.defconfig"

endif # BOARD_NRF52840_DONGLE
```

## boards/makerdiary/nrf52840_dongle/Kconfig.nrf52840_dongle
```kconfig
# Copyright (c) 2016-2025 Makerdiary <https://makerdiary.com>
# SPDX-License-Identifier: Apache-2.0

config BOARD_NRF52840_DONGLE
	select SOC_NRF52840_QIAA
```

## samples/adc/sample.yaml
```yaml
sample:
  name: ADC devicetree driver sample
tests:
  sample.adc:
    sysbuild: true
    build_only: true
    integration_platforms:
      - nrf52840_dongle/nrf52840
```

## samples/blinky/sample.yaml
```yaml
sample:
  name: Blinky Sample
tests:
  sample.blinky:
    sysbuild: true
    build_only: true
    integration_platforms:
      - nrf52840_dongle/nrf52840
```

## samples/hello_world/sample.yaml
```yaml
sample:
  name: Hello World Sample
tests:
  sample.helloworld:
    sysbuild: true
    build_only: true
    integration_platforms:
      - nrf52840_dongle/nrf52840
```

## west.yml
```yaml
# Copyright (c) 2016-2025 Makerdiary <https://makerdiary.com>
# SPDX-License-Identifier: Apache-2.0

manifest:
  self: 
    path: nrf52840-mdk-usb-dongle

  remotes:
    - name: makerdiary
      url-base: https://github.com/makerdiary
    - name: zephyrproject-rtos
      url-base: https://github.com/zephyrproject-rtos
    - name: nrfconnect
      url-base: https://github.com/nrfconnect

  projects:
    - name: nrf
      remote: nrfconnect
      repo-path: sdk-nrf
      revision: v3.1.1
      import: true
```
